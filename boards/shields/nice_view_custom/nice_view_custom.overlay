/*
 * Copyright (c) 2024 Your Name
 * SPDX-License-Identifier: MIT
 */

#include <dt-bindings/zmk/matrix_transform.h>

/ {
    chosen {
        zephyr,display = &nice_view_spi;
    };

    nice_view_spi: &spi0 {
        compatible = "nordic,nrf-spim";
        status = "okay";
        cs-gpios = <&gpio0 6 GPIO_ACTIVE_HIGH>;
        
        nice_view: ssd1306@0 {
            compatible = "solomon,ssd1306fb";
            reg = <0>;
            spi-max-frequency = <10000000>;
            width = <128>;
            height = <64>;
            segment-offset = <0>;
            page-offset = <0>;
            display-offset = <0>;
            multiplex-ratio = <63>;
            segment-remap;
            com-invdir;
            com-sequential;
            prechargep = <0x22>;
        };
    };
};
